## config/west.yml
```yaml
manifest:
  remotes:
    - name: cormoran
      url-base: https://github.com/cormoran

    - name: badjeff
      url-base: https://github.com/badjeff

    - name: caksoylar
      url-base: https://github.com/caksoylar

    - name: takamaru-fpv
      url-base: https://github.com/takamaru-fpv

    - name: kot149
      url-base: https://github.com/kot149

  projects:
    # ZMK (Cormoran fork)
    - name: zmk
      remote: cormoran
      revision: v0.3-branch+dya
      import: app/west.yml

    # Battery
    - name: zmk-feature-non-lipo-battery-management
      remote: takamaru-fpv
      revision: voltage_division

    # DYA Studio modules
    - name: zmk-module-ble-management
      remote: cormoran
      revision: zmk-v0.3.0.0

    - name: zmk-module-battery-history
      remote: cormoran
      revision: main

    - name: zmk-module-settings-rpc
      remote: cormoran
      revision: main

    - name: zmk-module-runtime-input-processor
      remote: cormoran
      revision: zmk-v0.3.0.0

    # PMW3610
    - name: zmk-pmw3610-driver
      remote: badjeff
      revision: zmk-0.3

    # RGB LED
    - name: zmk-rgbled-widget
      remote: caksoylar
      revision: v0.3-branch

    # Scroll Snap
    - name: zmk-scroll-snap
      remote: kot149
      revision: v1

  self:
    path: config
```
